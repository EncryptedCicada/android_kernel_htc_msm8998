/* Copyright (c) 2016-2017, The Linux Foundation. All rights reserved.
 *
 * This program is free software; you can redistribute it and/or modify
 * it under the terms of the GNU General Public License version 2 and
 * only version 2 as published by the Free Software Foundation.
 *
 * This program is distributed in the hope that it will be useful,
 * but WITHOUT ANY WARRANTY; without even the implied warranty of
 * MERCHANTABILITY or FITNESS FOR A PARTICULAR PURPOSE.  See the
 * GNU General Public License for more details.
 */

qcom,longcheer_3600mah {
	/* 3494336_Longcheer_L2052_jiade_3600mah_averaged_MasterSlave_Jul9th2018 */
	qcom,max-voltage-uv = <4400000>;
	qcom,fg-cc-cv-threshold-mv = <4390>;
	qcom,fastchg-current-ma = <2150>;
	qcom,batt-id-kohm = <47>;
	qcom,battery-beta = <3435>;
	qcom,battery-type = "longcheer_l2052_jiade_3600mah_averaged_masterslave_jan10th2017";
	qcom,checksum = <0x107>;
	qcom,gui-version = "PPM660GUI - 0.0.0.45";
	qcom,fg-profile-data = [
		B0 1E 97 FD
		D1 02 DF F5
		E4 1C B9 FB
		EC 0D 62 0A
		E8 17 BF 23
		78 44 47 5A
		70 00 00 00
		10 00 00 00
		00 00 08 B5
		40 CD 89 C2
		25 00 08 00
		82 DA A8 E5
		25 05 D1 FB
		FF 04 06 12
		0A D5 7E 2A
		33 06 09 20
		27 00 14 00
		0F 1F 88 06
		3E 03 E5 F4
		8B 1C C7 03
		2A 15 31 13
		49 18 57 2A
		E4 4C DF 62
		5C 00 00 00
		0B 00 00 00
		00 00 F8 CC
		2A CA 9F C5
		18 00 00 00
		71 E3 A8 E5
		73 FC 0F FA
		7F F5 DD 02
		AA F3 5C 22
		B9 33 CC FF
		07 10 00 00
		04 0E 66 46
		18 00 40 00
		B9 01 0A FA
		FF 00 00 00
		00 00 00 00
		00 00 00 00
		00 00 00 00
		00 00 00 00
		00 00 00 00
		00 00 00 00
		00 00 00 00
		00 00 00 00
		00 00 00 00
		00 00 00 00
		00 00 00 00
		00 00 00 00
		00 00 00 00
		00 00 00 00
		00 00 00 00
		00 00 00 00
		00 00 00 00
		00 00 00 00
		];   
};
