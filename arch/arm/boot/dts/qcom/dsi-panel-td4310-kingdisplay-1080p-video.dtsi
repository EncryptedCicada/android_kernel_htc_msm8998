/* Copyright (c) 2019, The Linux Foundation. All rights reserved.
 *
 * This program is free software; you can redistribute it and/or modify
 * it under the terms of the GNU General Public License version 2 and
 * only version 2 as published by the Free Software Foundation.
 *
 * This program is distributed in the hope that it will be useful,
 * but WITHOUT ANY WARRANTY; without even the implied warranty of
 * MERCHANTABILITY or FITNESS FOR A PARTICULAR PURPOSE.  See the
 * GNU General Public License for more details.
 */

&mdss_mdp {
    dsi_td4310_kingdisplay_1080_video: qcom,mdss_dsi_td4310_kingdisplay_1080p_video {
        qcom,mdss-dsi-panel-name = 
                "kingdisplay td4310 1080p video mode dsi panel";
        qcom,mdss-dsi-panel-type = "dsi_video_mode";
        qcom,mdss-dsi-panel-framerate = <60>;
        qcom,mdss-dsi-virtual-channel-id = <0>;
        qcom,mdss-dsi-stream = <0>;
        qcom,mdss-dsi-panel-width = <1080>;
        qcom,mdss-dsi-panel-height = <2160>;
        qcom,mdss-dsi-h-front-porch = <95>;
        qcom,mdss-dsi-h-back-porch = <18>;
        qcom,mdss-dsi-h-pulse-width = <2>;
        qcom,mdss-dsi-h-sync-skew = <0>;
        qcom,mdss-dsi-v-back-porch = <33>;
        qcom,mdss-dsi-v-front-porch = <4>;
        qcom,mdss-dsi-v-pulse-width = <2>;
        qcom,mdss-dsi-h-left-border = <0>;
        qcom,mdss-dsi-h-right-border = <0>;
        qcom,mdss-dsi-v-top-border = <0>;
        qcom,mdss-dsi-v-bottom-border = <0>;
        qcom,mdss-dsi-bpp = <24>;
        qcom,mdss-dsi-underflow-color = <0xff>;
        qcom,mdss-dsi-border-color = <0>;
        qcom,mdss-dsi-h-sync-pulse = <0>;
        qcom,mdss-dsi-traffic-mode = "burst_mode";
        qcom,mdss-dsi-bllp-eof-power-mode;
        qcom,mdss-dsi-bllp-power-mode;
        qcom,mdss-dsi-lane-0-state;
        qcom,mdss-dsi-lane-1-state;
        qcom,mdss-dsi-lane-2-state;
        qcom,mdss-dsi-lane-3-state;
        qcom,mdss-dsi-panel-timings = [e6 38 26 00 68 6e 2a 3c 44
            03 04 00];
        qcom,mdss-dsi-t-clk-post = <0x02>;
        qcom,mdss-dsi-t-clk-pre = <0x2d>;
        qcom,mdss-dsi-bl-min-level = <1>;
        qcom,mdss-dsi-bl-max-level = <4095>;
        qcom,mdss-dsi-dma-trigger = "trigger_sw";
        qcom,mdss-dsi-mdp-trigger = "none";
        qcom,mdss-dsi-on-command = [29 01 00 00 00 00 02 b0 00
            29 01 00 00 00 00 02 d6 01
            29 01 00 00 00 00 27 c7 07
            17 23 34 43 4f 68 7a 87 93
            46 53 62 78 81 8d 9b a6 b2
            07 16 22 33 42 4e 67 79 87
            93 46 53 62 78 81 8d 9b a6
            b2 29 01 00 00 00 00 38 c8
            01 00 01 01 02 fc 00 00 01
            01 02 fc 00 00 01 f8 ff fc
            00 00 00 00 00 fc 00 00 00
            00 00 fc 00 00 00 00 00 fc
            00 00 00 00 00 fc 00 00 00
            00 00 fc 00 00 00 00 00 fc
            00 05 01 00 00 46 00 02 11
            00 05 01 00 00 14 00 02 29
            00];
        qcom,mdss-dsi-off-command = [05 01 00 00 14 00 02 28 00
            05 01 00 00 78 00 02 10 00];
        qcom,mdss-dsi-on-command-state = "dsi_lp_mode";
        qcom,mdss-dsi-off-command-state = "dsi_hs_mode";
        qcom,mdss-dsi-bl-pmic-control-type = "bl_ctrl_wled";
        qcom,mdss-dsi-reset-sequence = <1 2>, <0 13>, <1 55>;
        qcom,mdss-dsi-tx-eot-append;
        qcom,mdss-dsi-post-init-delay = <1>;
        qcom,esd-check-enabled;
        qcom,mdss-dsi-panel-status-command = [06 01 00 01 05 00 01 0a];
        qcom,mdss-dsi-panel-status-command-mode = "dsi_lp_mode";
        qcom,mdss-dsi-panel-status-check-mode = "reg_read";
        qcom,mdss-dsi-panel-status-read-length = <1>;
        qcom,mdss-dsi-panel-status-value = <28>;
        qcom,mdss-dsi-panel-max-error-count = <3>;
        qcom,mdss-pan-physical-width-dimension = <67>;
        qcom,mdss-pan-physical-height-dimension = <136>;
        qcom,mdss-dsi-panel-timings-phy-v2 = [24 20 08 09 05 03 04 a0
            24 20 08 09 05 03 04 a0
            24 20 08 09 05 03 04 a0
            24 20 08 09 05 03 04 a0
            24 1d 08 09 05 03 04 a0];
        qcom,mdss-dsi-min-refresh-rate = <48>;
        qcom,mdss-dsi-max-refresh-rate = <60>;
    };
};
