/* Copyright (c) 2019, The Linux Foundation. All rights reserved.
 *
 * This program is free software; you can redistribute it and/or modify
 * it under the terms of the GNU General Public License version 2 and
 * only version 2 as published by the Free Software Foundation.
 *
 * This program is distributed in the hope that it will be useful,
 * but WITHOUT ANY WARRANTY; without even the implied warranty of
 * MERCHANTABILITY or FITNESS FOR A PARTICULAR PURPOSE.  See the
 * GNU General Public License for more details.
 */

&mdss_mdp {
	dsi_nt36672_truly_video: qcom,mdss_dsi_nt36672_truly_video {
		qcom,mdss-dsi-panel-name =
				"nt36672 truly fhd video mode dsi panel";
		qcom,mdss-dsi-panel-type = "dsi_video_mode";
		qcom,mdss-dsi-virtual-channel-id = <0>;
		qcom,mdss-dsi-stream = <0>;
		qcom,mdss-dsi-panel-width = <1080>;
		qcom,mdss-dsi-panel-height = <2160>;
		qcom,mdss-dsi-h-front-porch = <42>;
		qcom,mdss-dsi-h-back-porch = <42>;
		qcom,mdss-dsi-h-pulse-width = <10>;
		qcom,mdss-dsi-h-sync-skew = <0>;
		qcom,mdss-dsi-v-back-porch = <15>;
		qcom,mdss-dsi-v-front-porch = <10>;
		qcom,mdss-dsi-v-pulse-width = <3>;
		qcom,mdss-dsi-h-sync-pulse = <0>;
		qcom,mdss-dsi-h-left-border = <0>;
		qcom,mdss-dsi-h-right-border = <0>;
		qcom,mdss-dsi-v-top-border = <0>;
		qcom,mdss-dsi-v-bottom-border = <0>;
		qcom,mdss-dsi-panel-framerate = <55>;
		qcom,mdss-dsi-bpp = <24>;
		qcom,mdss-dsi-underflow-color = <0xff>;
		qcom,mdss-dsi-border-color = <0>;
		qcom,mdss-dsi-traffic-mode = "burst_mode";
		qcom,mdss-dsi-bllp-eof-power-mode;
		qcom,mdss-dsi-bllp-power-mode;
		qcom,mdss-dsi-lane-0-state;
		qcom,mdss-dsi-lane-1-state;
		qcom,mdss-dsi-lane-2-state;
		qcom,mdss-dsi-lane-3-state;
		qcom,mdss-dsi-panel-timings = [e6 38 26 00 68 6e 2a 3c 44 03 04 00];
		qcom,mdss-dsi-t-clk-post = <0x0d>;
		qcom,mdss-dsi-t-clk-pre = <0x32>;
		qcom,mdss-dsi-bl-min-level = <1>;
		qcom,mdss-dsi-bl-max-level = <4095>;
		qcom,mdss-dsi-dma-trigger = "trigger_sw";
		qcom,mdss-dsi-mdp-trigger = "none";
		qcom,mdss-dsi-on-command = [15 01 00 00 00 00 02 ff 20
			15 01 00 00 00 00 02 fb 01
			15 01 00 00 00 00 02 01 33
			15 01 00 00 00 00 02 06 99
			15 01 00 00 00 00 02 07 9e
			15 01 00 00 00 00 02 0e 30
			15 01 00 00 00 00 02 0f 2e
			15 01 00 00 00 00 02 1d 33
			15 01 00 00 00 00 02 6d 66
			15 01 00 00 00 00 02 68 03
			15 01 00 00 00 00 02 69 99
			15 01 00 00 00 00 02 95 b9
			15 01 00 00 00 00 02 96 b9
			15 01 00 00 00 00 02 ff 23
			15 01 00 00 00 00 02 fb 01
			15 01 00 00 00 00 02 12 6c
			15 01 00 00 00 00 02 15 e6
			15 01 00 00 00 00 02 16 0c
			15 01 00 00 00 00 02 ff 24
			15 01 00 00 00 00 02 fb 01
			15 01 00 00 00 00 02 00 01
			15 01 00 00 00 00 02 01 1c
			15 01 00 00 00 00 02 02 0b
			15 01 00 00 00 00 02 03 0c
			15 01 00 00 00 00 02 04 29
			15 01 00 00 00 00 02 05 0f
			15 01 00 00 00 00 02 06 0f
			15 01 00 00 00 00 02 07 03
			15 01 00 00 00 00 02 08 05
			15 01 00 00 00 00 02 09 22
			15 01 00 00 00 00 02 0a 00
			15 01 00 00 00 00 02 0b 24
			15 01 00 00 00 00 02 0c 13
			15 01 00 00 00 00 02 0d 13
			15 01 00 00 00 00 02 0e 15
			15 01 00 00 00 00 02 0f 15
			15 01 00 00 00 00 02 10 17
			15 01 00 00 00 00 02 11 17
			15 01 00 00 00 00 02 12 01
			15 01 00 00 00 00 02 13 1c
			15 01 00 00 00 00 02 14 0b
			15 01 00 00 00 00 02 15 0c
			15 01 00 00 00 00 02 16 29
			15 01 00 00 00 00 02 17 0f
			15 01 00 00 00 00 02 18 0f
			15 01 00 00 00 00 02 19 04
			15 01 00 00 00 00 02 1a 06
			15 01 00 00 00 00 02 1b 23
			15 01 00 00 00 00 02 1c 0f
			15 01 00 00 00 00 02 1d 24
			15 01 00 00 00 00 02 1e 13
			15 01 00 00 00 00 02 1f 13
			15 01 00 00 00 00 02 20 15
			15 01 00 00 00 00 02 21 15
			15 01 00 00 00 00 02 22 17
			15 01 00 00 00 00 02 23 17
			15 01 00 00 00 00 02 2f 04
			15 01 00 00 00 00 02 30 08
			15 01 00 00 00 00 02 31 04
			15 01 00 00 00 00 02 32 08
			15 01 00 00 00 00 02 33 04
			15 01 00 00 00 00 02 34 04
			15 01 00 00 00 00 02 35 00
			15 01 00 00 00 00 02 37 09
			15 01 00 00 00 00 02 38 75
			15 01 00 00 00 00 02 39 75
			15 01 00 00 00 00 02 3b c0
			15 01 00 00 00 00 02 3f 75
			15 01 00 00 00 00 02 60 10
			15 01 00 00 00 00 02 61 00
			15 01 00 00 00 00 02 68 c2
			15 01 00 00 00 00 02 78 80
			15 01 00 00 00 00 02 79 23
			15 01 00 00 00 00 02 7a 10
			15 01 00 00 00 00 02 7b 9b
			15 01 00 00 00 00 02 7c 80
			15 01 00 00 00 00 02 7d 06
			15 01 00 00 00 00 02 7e 02
			15 01 00 00 00 00 02 8e f0
			15 01 00 00 00 00 02 92 76
			15 01 00 00 00 00 02 93 0a
			15 01 00 00 00 00 02 94 0a
			15 01 00 00 00 00 02 99 33
			15 01 00 00 00 00 02 9b ff
			15 01 00 00 00 00 02 9f 00
			15 01 00 00 00 00 02 a3 91
			15 01 00 00 00 00 02 b3 00
			15 01 00 00 00 00 02 b4 00
			15 01 00 00 00 00 02 b5 04
			15 01 00 00 00 00 02 dc 40
			15 01 00 00 00 00 02 dd 03
			15 01 00 00 00 00 02 de 01
			15 01 00 00 00 00 02 df 3d
			15 01 00 00 00 00 02 e0 3d
			15 01 00 00 00 00 02 e1 22
			15 01 00 00 00 00 02 e2 24
			15 01 00 00 00 00 02 e3 0a
			15 01 00 00 00 00 02 e4 0a
			15 01 00 00 00 00 02 e8 01
			15 01 00 00 00 00 02 e9 10
			15 01 00 00 00 00 02 ed 40
			15 01 00 00 00 00 02 ff 25
			15 01 00 00 00 00 02 fb 01
			15 01 00 00 00 00 02 0a 81
			15 01 00 00 00 00 02 0b cd
			15 01 00 00 00 00 02 0c 01
			15 01 00 00 00 00 02 17 82
			15 01 00 00 00 00 02 21 1b
			15 01 00 00 00 00 02 22 1b
			15 01 00 00 00 00 02 24 76
			15 01 00 00 00 00 02 25 76
			15 01 00 00 00 00 02 30 2a
			15 01 00 00 00 00 02 31 2a
			15 01 00 00 00 00 02 38 2a
			15 01 00 00 00 00 02 3f 11
			15 01 00 00 00 00 02 40 3a
			15 01 00 00 00 00 02 42 22
			15 01 00 00 00 00 02 43 8e
			15 01 00 00 00 00 02 44 8e
			15 01 00 00 00 00 02 4b 21
			15 01 00 00 00 00 02 4c 3a
			15 01 00 00 00 00 02 4d 8e
			15 01 00 00 00 00 02 58 22
			15 01 00 00 00 00 02 59 05
			15 01 00 00 00 00 02 5a 0a
			15 01 00 00 00 00 02 5b 0a
			15 01 00 00 00 00 02 5c 25
			15 01 00 00 00 00 02 5d 80
			15 01 00 00 00 00 02 5e 80
			15 01 00 00 00 00 02 5f 28
			15 01 00 00 00 00 02 62 3f
			15 01 00 00 00 00 02 63 82
			15 01 00 00 00 00 02 65 00
			15 01 00 00 00 00 02 66 dd
			15 01 00 00 00 00 02 6c 6d
			15 01 00 00 00 00 02 71 6d
			15 01 00 00 00 00 02 78 25
			15 01 00 00 00 00 02 c3 00
			15 01 00 00 00 00 02 ff 26
			15 01 00 00 00 00 02 fb 01
			15 01 00 00 00 00 02 06 c8
			15 01 00 00 00 00 02 12 5a
			15 01 00 00 00 00 02 19 09
			15 01 00 00 00 00 02 1a 84
			15 01 00 00 00 00 02 1c fa
			15 01 00 00 00 00 02 1d 09
			15 01 00 00 00 00 02 1e 0b
			15 01 00 00 00 00 02 29 b4
			15 01 00 00 00 00 02 33 14
			15 01 00 00 00 00 02 34 ea
			15 01 00 00 00 00 02 36 fa
			15 01 00 00 00 00 02 37 14
			15 01 00 00 00 00 02 38 71
			15 01 00 00 00 00 02 99 20
			15 01 00 00 00 00 02 ff 27
			15 01 00 00 00 00 02 fb 01
			15 01 00 00 00 00 02 13 08
			15 01 00 00 00 00 02 14 43
			15 01 00 00 00 00 02 16 b8
			15 01 00 00 00 00 02 17 b8
			15 01 00 00 00 00 02 7a 02
			15 01 00 00 00 00 02 ff 10
			15 01 00 00 00 00 02 fb 01
			05 01 00 00 c8 00 02 11 00
			05 01 00 00 96 00 02 29 00];
		qcom,mdss-dsi-off-command = [05 01 00 00 14 00 02 28 00
			05 01 00 00 78 00 02 10 00];
		qcom,mdss-dsi-on-command-state = "dsi_lp_mode";
		qcom,mdss-dsi-off-command-state = "dsi_lp_mode";
		qcom,mdss-dsi-bl-pmic-control-type = "bl_ctrl_wled";
		qcom,mdss-dsi-reset-sequence = <01 10>, <0 10>, <1 10>;
		qcom,mdss-dsi-tx-eot-append;
		qcom,mdss-dsi-post-init-delay = <1>;
		qcom,mdss-dsi-panel-timings-phy-v2 = [23 1f 07 09 05 03 04 a0
			23 1f 07 09 05 03 04 a0
			23 1f 07 09 05 03 04 a0
			23 1f 07 09 05 03 04 a0
			23 19 08 08 05 03 04 a0];
		qcom,mdss-dsi-min-refresh-rate = <48>;
		qcom,mdss-dsi-max-refresh-rate = <60>;
	};
};
